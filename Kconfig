## Kconfig
```kconfig
config RAINDROP_MODULE
    bool
    prompt "RAINDROP_MODULE."
    default n
    depends on ENABLE_WS63_DSWDBD
    help
        This option means enable the sample of RAINDROP_MODULE.
if RAINDROP_MODULE_SAMPLE
menu "ADC Sample Configuration"
    osource "application/samples/ws63_dswdbd/raindrop_module/Kconfig"
endmenu
endif

config SERVO_MODULE
    bool
    prompt "SERVO_MODULE."
    default n
    depends on ENABLE_WS63_DSWDBD
    help
        This option means enable the sample of SERVO_MODULE.

config ENVIRONMENT_MODULE
    bool
    prompt "ENIRONMENT_MODULE."
    default n
    depends on ENABLE_WS63_DSWDBD
    help
        This option means enable the sample of ENIRONMENT_MODULE.

config RADAR_MODULE
    bool
    prompt "RADAR_MODULE."
    default n
    depends on ENABLE_WS63_DSWDBD
    help
        This option means enable the sample of ENIRONMENT_MODULE.
if RADAR_MODULE
    osource "application/samples/ws63_dswdbd/radar_module/Kconfig"
endif

config PIR_MODULE
    bool
    prompt "PIR_MODULE."
    default n
    depends on ENABLE_WS63_DSWDBD
    help
        This option means enable the sample of PIR_MODULE.

config OLED_MODULE
    bool
    prompt "OLED_MODULE."
    default n
    depends on ENABLE_WS63_DSWDBD
    help
        This option means enable the sample of OLED_MODULE.

config MAIN
    bool
    prompt "MAIN."
    default n
    depends on ENABLE_WS63_DSWDBD
    help
        This option means enable the sample of MAIN
if MAIN
menu "ADC Configuration"
    osource "application/samples/ws63_dswdbd/main/Kconfig"
endmenu
endif

config BEEP_MODULE
    bool
    prompt "BEEP_MODULE."
    default n
    depends on ENABLE_WS63_DSWDBD
    help
        This option means enable the sample of BEEP_MODULE

config BH1750_MODULE
    bool
    prompt "BH1750_MODULE."
    default n
    depends on ENABLE_WS63_DSWDBD
    help
        This option means enable the sample of BH1750_MODULE

config MQTT_MODULE
    bool
    prompt "MQTT_MODULE."
    default n
    depends on ENABLE_WS63_DSWDBD
    help
        This option means enable the sample of MQTT_MODULE
        
```

## main/Kconfig
```kconfig
#===============================================================================
# @brief    Kconfig file.
# Copyright (c) HiSilicon (Shanghai) Technologies Co., Ltd. 2023-2023. All rights reserved.
#===============================================================================
config HADC_SELF_CALIBRATION
    bool
    prompt "HADC calibration, or use record code."
    default y
    depends on ADC_USING_V152

config HADC_SAMPLE
    bool
    prompt "Enable HADC sample."
    default y
    depends on ADC_USING_V152

config TIMING_SAMPLE
    bool
    prompt "Create timing sample irq."
    default n


config ADC_SUPPORT_AUTO_SCAN
    bool
    prompt "Enable ADC auto scan support"
    default y
    help
      Enable automatic scanning mode for ADC channels.

config ADC_SUPPORT_LONG_SAMPLE
    bool
    prompt "Enable ADC long sample time support"
    default y
    depends on ADC_SUPPORT_AUTO_SCAN
    help
      Enable long sampling time configuration for ADC scan.
```

## radar_module/Kconfig
```kconfig
#===============================================================================
# @brief    Kconfig file.
# Copyright (c) @CompanyNameMagicTag 2023-2023. All rights reserved.
#===============================================================================
config RADAR_STA
    bool
    prompt "Support RADAR_STA Sample."
    default n
    depends on RADAR_MODULE
    help
        This option means support RADAR_STA Sample.

config RADAR_SOFTAP
    bool
    prompt "Support RADAR_SOFTAP Sample."
    default n
    depends on RADAR_MODULE
    help
        This option means support RADAR_SOFTAP Sample.
```
